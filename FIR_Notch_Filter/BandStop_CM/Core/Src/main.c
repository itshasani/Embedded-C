/* USER CODE BEGIN Header */
/**
  ******************************************************************************
  * @file           : main.c
  * @brief          : Main program body
  ******************************************************************************
  * @attention
  *
  * Copyright (c) 2024 STMicroelectronics.
  * All rights reserved.
  *
  * This software is licensed under terms that can be found in the LICENSE file
  * in the root directory of this software component.
  * If no LICENSE file comes with this software, it is provided AS-IS.
  *
  ******************************************************************************
  */
/* USER CODE END Header */
/* Includes ------------------------------------------------------------------*/
#include "main.h"

/* Private includes ----------------------------------------------------------*/
/* USER CODE BEGIN Includes */
#include <string.h>
#define ARM_MATH_CM4
#include "arm_math.h"
/* USER CODE END Includes */

/* Private typedef -----------------------------------------------------------*/
/* USER CODE BEGIN PTD */

/* USER CODE END PTD */

/* Private define ------------------------------------------------------------*/
/* USER CODE BEGIN PD */

/* USER CODE END PD */

/* Private macro -------------------------------------------------------------*/
/* USER CODE BEGIN PM */

/* USER CODE END PM */

/* Private variables ---------------------------------------------------------*/
TIM_HandleTypeDef htim5;

UART_HandleTypeDef huart2;

/* USER CODE BEGIN PV */
uint16_t sampleIn, sampleOut, sampleOld;
float dataIn;
uint8_t state , trigData;
float dataOut, dataInArray[5030] , dataOutArray[5030];

uint32_t usRefCnt[5027] , usCnt[5027];

float timeA;

float32_t filter_v4coeff_ASN[65] = {
		0.08958515735,-0.35641307302, -0.08816439163, -0.01673164760
		,  0.00267671775,  0.00084990737, -0.00631196308, -0.00603705704,
		  0.00207753587,  0.00743013163,  0.00284795312
		, -0.00564425406, -0.00662824652,  0.00129517476
		,  0.00747909952, 0.00392119045
		, -0.00521757386, -0.00688232905,  0.00007347480,  0.00763708999
		,  0.00488166687, -0.00444294017, -0.00755898860, -0.00049117998
		,  0.00729939486,  0.00547822890, -0.00355743075, -0.00784931271, -0.00185963258
		,  0.00646202821, 0.00616345406, -0.00258174936,  0.99254268155
		, -0.00258174936,  0.00616345406,  0.00646202821, -0.00185963258, -0.00784931271
		, -0.00355743075,  0.00547822890
		, 0.00729939486, -0.00049117998, -0.00755898860, -0.00444294017
		,  0.00488166687,  0.00763708999,  0.00007347480, -0.00688232905
		, -0.00521757386,  0.00392119045,  0.00747909952,  0.00129517476
		, -0.00662824652, -0.00564425406,  0.00284795312,  0.00743013163
		,  0.00207753587, -0.00603705704, -0.00631196308,  0.00084990737
		,  0.00267671775,-0.01673164760, -0.08816439163, -0.35641307302
		,  0.08958515735
};
float32_t real64_TB[486] = {
  -0.000952060804133, -0.00511850896509, 0.001076579968211,-0.0009265011144901,
  -0.0004804320994588,0.0003492303232949,0.0007332388711938,0.0001538093143762,
  -0.0006066743612229,-0.0005652402729948,0.0002105236464822,0.0007058189794176,
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   0.001076579968211, -0.00511850896509
};
float32_t FINAL[100] = {
		  -0.003257675184696, 0.008653369276161, 0.009529586358114,-0.002769580821533,
		   -0.01219544076738,-0.005434301972044, 0.009345626775536,  0.01225161588417,
		  -0.001560589533813, -0.01413014286101, -0.00803356270546, 0.009490465597452,
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		   -0.01219544076738,-0.002769580821533, 0.009529586358114, 0.008653369276161,
};



/* -------------------------------------------------------------------------------------------------*/



float32_t FIRstateF32[1024 + 1160 -1 ];
/* USER CODE END PV */

/* Private function prototypes -----------------------------------------------*/
void SystemClock_Config(void);
static void MX_GPIO_Init(void);
static void MX_USART2_UART_Init(void);
static void MX_TIM5_Init(void);
/* USER CODE BEGIN PFP */

/* USER CODE END PFP */

/* Private user code ---------------------------------------------------------*/
/* USER CODE BEGIN 0 */

/* USER CODE END 0 */

/**
  * @brief  The application entry point.
  * @retval int
  */
int main(void)
{

  /* USER CODE BEGIN 1 */

  /* USER CODE END 1 */

  /* MCU Configuration--------------------------------------------------------*/

  /* Reset of all peripherals, Initializes the Flash interface and the Systick. */
  HAL_Init();

  /* USER CODE BEGIN Init */

  /* USER CODE END Init */

  /* Configure the system clock */
  SystemClock_Config();

  /* USER CODE BEGIN SysInit */

  /* USER CODE END SysInit */

  /* Initialize all configured peripherals */
  MX_GPIO_Init();
  MX_USART2_UART_Init();
  MX_TIM5_Init();
  /* USER CODE BEGIN 2 */
/*
  int k;
  for(k=0;k < 1160;k++)
  {
	  if ((aFIR_F32_Coeffs[k] > 0) & (aFIR_F32_Coeffs[k] < 0.001))
	  {
		  aFIR_F32_Coeffs[k] =0;
	  }
	  if ((aFIR_F32_Coeffs[k] < 0) & (aFIR_F32_Coeffs[k] < -0.001))
	  {
		  aFIR_F32_Coeffs[k] =0;
	  }
  }
*/
  sampleOld = 0;
  sampleIn = 0;
  sampleOut = 1;
  dataIn = 0;
  dataOut = 0;
  timeA = 0;
  trigData = 0;
  memset(dataInArray,0,sizeof(dataInArray));
  memset(dataOutArray,0,sizeof(dataOutArray));

  memset(usRefCnt,0,sizeof(usRefCnt));
  memset(usCnt,0,sizeof(usCnt));
 // usRefCnt = 0;
 // usCnt = 0;

  /* USER CODE END 2 */

  /* Infinite loop */
  /* USER CODE BEGIN WHILE */
  while (1)
  {
    /* USER CODE END WHILE */

    /* USER CODE BEGIN 3 */
	  switch (state) {
			// copy each sample to input array
	  case 0:
		  	  if(sampleIn != sampleOld)
		  	  {
		  		  dataInArray[sampleIn - 1] = dataIn;
		  		  sampleOld ++;
		  	  }
		  	  if (sampleOld == 5026)
		  	  {
		  		 sampleOld = 0;
		  		 sampleOut = 1;
		  		 state =1 ;
		  	  }
			break;
	  case 1:
		  	  // copy data in array to data out array
		  int n;
		  int i;

		  for (n = 0;n < 5027;n++)
		  {
			  usRefCnt[n] = __HAL_TIM_GET_COUNTER(&htim5);
			  for (i=0 ; i < 65;i++)
			  {
				  if((n-i) < 0)
				  {
					  break;
				  }
				  else
				  {
				  dataOutArray[n] += filter_v4coeff_ASN[i]*dataInArray[n-i];
				  }
			  }
			  usCnt[n] =  __HAL_TIM_GET_COUNTER(&htim5) - usRefCnt[n];
		  }

		  state = 2;
		  break;
	  case 2:
		  	  // with some proper sampling time copy each output array to data out variable
		  dataOut = dataOutArray[sampleOut - 1];
		  HAL_Delay(25);
		  trigData = 1;
		  HAL_Delay(25);
		  trigData = 0;
		  timeA = usCnt[sampleOut -1];
		  sampleOut ++;
		  if(sampleOut == 5026)
		  {
			  sampleOut = 1;
			  state = 3;
		  }
		  break;
	  case 3 :
		  	 break;

	}
  }
  /* USER CODE END 3 */
}

/**
  * @brief System Clock Configuration
  * @retval None
  */
void SystemClock_Config(void)
{
  RCC_OscInitTypeDef RCC_OscInitStruct = {0};
  RCC_ClkInitTypeDef RCC_ClkInitStruct = {0};

  /** Configure the main internal regulator output voltage
  */
  __HAL_RCC_PWR_CLK_ENABLE();
  __HAL_PWR_VOLTAGESCALING_CONFIG(PWR_REGULATOR_VOLTAGE_SCALE1);

  /** Initializes the RCC Oscillators according to the specified parameters
  * in the RCC_OscInitTypeDef structure.
  */
  RCC_OscInitStruct.OscillatorType = RCC_OSCILLATORTYPE_HSI;
  RCC_OscInitStruct.HSIState = RCC_HSI_ON;
  RCC_OscInitStruct.HSICalibrationValue = RCC_HSICALIBRATION_DEFAULT;
  RCC_OscInitStruct.PLL.PLLState = RCC_PLL_ON;
  RCC_OscInitStruct.PLL.PLLSource = RCC_PLLSOURCE_HSI;
  RCC_OscInitStruct.PLL.PLLM = 8;
  RCC_OscInitStruct.PLL.PLLN = 180;
  RCC_OscInitStruct.PLL.PLLP = RCC_PLLP_DIV4;
  RCC_OscInitStruct.PLL.PLLQ = 2;
  RCC_OscInitStruct.PLL.PLLR = 2;
  if (HAL_RCC_OscConfig(&RCC_OscInitStruct) != HAL_OK)
  {
    Error_Handler();
  }

  /** Activate the Over-Drive mode
  */
  if (HAL_PWREx_EnableOverDrive() != HAL_OK)
  {
    Error_Handler();
  }

  /** Initializes the CPU, AHB and APB buses clocks
  */
  RCC_ClkInitStruct.ClockType = RCC_CLOCKTYPE_HCLK|RCC_CLOCKTYPE_SYSCLK
                              |RCC_CLOCKTYPE_PCLK1|RCC_CLOCKTYPE_PCLK2;
  RCC_ClkInitStruct.SYSCLKSource = RCC_SYSCLKSOURCE_PLLRCLK;
  RCC_ClkInitStruct.AHBCLKDivider = RCC_SYSCLK_DIV1;
  RCC_ClkInitStruct.APB1CLKDivider = RCC_HCLK_DIV4;
  RCC_ClkInitStruct.APB2CLKDivider = RCC_HCLK_DIV2;

  if (HAL_RCC_ClockConfig(&RCC_ClkInitStruct, FLASH_LATENCY_5) != HAL_OK)
  {
    Error_Handler();
  }
}

/**
  * @brief TIM5 Initialization Function
  * @param None
  * @retval None
  */
static void MX_TIM5_Init(void)
{

  /* USER CODE BEGIN TIM5_Init 0 */

  /* USER CODE END TIM5_Init 0 */

  TIM_ClockConfigTypeDef sClockSourceConfig = {0};
  TIM_MasterConfigTypeDef sMasterConfig = {0};

  /* USER CODE BEGIN TIM5_Init 1 */

  /* USER CODE END TIM5_Init 1 */
  htim5.Instance = TIM5;
  htim5.Init.Prescaler = 89;
  htim5.Init.CounterMode = TIM_COUNTERMODE_UP;
  htim5.Init.Period = 4294967295;
  htim5.Init.ClockDivision = TIM_CLOCKDIVISION_DIV1;
  htim5.Init.AutoReloadPreload = TIM_AUTORELOAD_PRELOAD_ENABLE;
  if (HAL_TIM_Base_Init(&htim5) != HAL_OK)
  {
    Error_Handler();
  }
  sClockSourceConfig.ClockSource = TIM_CLOCKSOURCE_INTERNAL;
  if (HAL_TIM_ConfigClockSource(&htim5, &sClockSourceConfig) != HAL_OK)
  {
    Error_Handler();
  }
  sMasterConfig.MasterOutputTrigger = TIM_TRGO_RESET;
  sMasterConfig.MasterSlaveMode = TIM_MASTERSLAVEMODE_DISABLE;
  if (HAL_TIMEx_MasterConfigSynchronization(&htim5, &sMasterConfig) != HAL_OK)
  {
    Error_Handler();
  }
  /* USER CODE BEGIN TIM5_Init 2 */
  HAL_TIM_Base_Start(&htim5);
  /* USER CODE END TIM5_Init 2 */

}

/**
  * @brief USART2 Initialization Function
  * @param None
  * @retval None
  */
static void MX_USART2_UART_Init(void)
{

  /* USER CODE BEGIN USART2_Init 0 */

  /* USER CODE END USART2_Init 0 */

  /* USER CODE BEGIN USART2_Init 1 */

  /* USER CODE END USART2_Init 1 */
  huart2.Instance = USART2;
  huart2.Init.BaudRate = 115200;
  huart2.Init.WordLength = UART_WORDLENGTH_8B;
  huart2.Init.StopBits = UART_STOPBITS_1;
  huart2.Init.Parity = UART_PARITY_NONE;
  huart2.Init.Mode = UART_MODE_TX_RX;
  huart2.Init.HwFlowCtl = UART_HWCONTROL_NONE;
  huart2.Init.OverSampling = UART_OVERSAMPLING_16;
  if (HAL_UART_Init(&huart2) != HAL_OK)
  {
    Error_Handler();
  }
  /* USER CODE BEGIN USART2_Init 2 */

  /* USER CODE END USART2_Init 2 */

}

/**
  * @brief GPIO Initialization Function
  * @param None
  * @retval None
  */
static void MX_GPIO_Init(void)
{
  GPIO_InitTypeDef GPIO_InitStruct = {0};
/* USER CODE BEGIN MX_GPIO_Init_1 */
/* USER CODE END MX_GPIO_Init_1 */

  /* GPIO Ports Clock Enable */
  __HAL_RCC_GPIOC_CLK_ENABLE();
  __HAL_RCC_GPIOH_CLK_ENABLE();
  __HAL_RCC_GPIOA_CLK_ENABLE();
  __HAL_RCC_GPIOB_CLK_ENABLE();

  /*Configure GPIO pin Output Level */
  HAL_GPIO_WritePin(LD2_GPIO_Port, LD2_Pin, GPIO_PIN_RESET);

  /*Configure GPIO pin : B1_Pin */
  GPIO_InitStruct.Pin = B1_Pin;
  GPIO_InitStruct.Mode = GPIO_MODE_IT_FALLING;
  GPIO_InitStruct.Pull = GPIO_NOPULL;
  HAL_GPIO_Init(B1_GPIO_Port, &GPIO_InitStruct);

  /*Configure GPIO pin : LD2_Pin */
  GPIO_InitStruct.Pin = LD2_Pin;
  GPIO_InitStruct.Mode = GPIO_MODE_OUTPUT_PP;
  GPIO_InitStruct.Pull = GPIO_NOPULL;
  GPIO_InitStruct.Speed = GPIO_SPEED_FREQ_LOW;
  HAL_GPIO_Init(LD2_GPIO_Port, &GPIO_InitStruct);

/* USER CODE BEGIN MX_GPIO_Init_2 */
/* USER CODE END MX_GPIO_Init_2 */
}

/* USER CODE BEGIN 4 */

/* USER CODE END 4 */

/**
  * @brief  This function is executed in case of error occurrence.
  * @retval None
  */
void Error_Handler(void)
{
  /* USER CODE BEGIN Error_Handler_Debug */
  /* User can add his own implementation to report the HAL error return state */
  __disable_irq();
  while (1)
  {
  }
  /* USER CODE END Error_Handler_Debug */
}

#ifdef  USE_FULL_ASSERT
/**
  * @brief  Reports the name of the source file and the source line number
  *         where the assert_param error has occurred.
  * @param  file: pointer to the source file name
  * @param  line: assert_param error line source number
  * @retval None
  */
void assert_failed(uint8_t *file, uint32_t line)
{
  /* USER CODE BEGIN 6 */
  /* User can add his own implementation to report the file name and line number,
     ex: printf("Wrong parameters value: file %s on line %d\r\n", file, line) */
  /* USER CODE END 6 */
}
#endif /* USE_FULL_ASSERT */
